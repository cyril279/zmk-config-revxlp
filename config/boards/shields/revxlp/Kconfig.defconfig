## config/boards/shields/revxlp/Kconfig.defconfig
```kconfig
# Copyright (c) 2020 The ZMK Contributors
# SPDX-License-Identifier: MIT

if SHIELD_REVXLP

config ZMK_KEYBOARD_NAME
    default "revxlp"

if ZMK_BACKLIGHT

config PWM
    default y

config LED_PWM
    default y

endif # ZMK_BACKLIGHT

endif
```

## config/boards/shields/revxlp/boards/seeeduino_xiao.conf
```kconfig
CONFIG_SPI=y
CONFIG_ZMK_KSCAN_MATRIX_POLLING=y
CONFIG_PWM_SAM0_TCC=y
CONFIG_ZMK_USB_LOGGING=y
```
